## layers/meta-hmi/conf/distro/hmi.conf
```bitbake
require conf/distro/poky.conf

DISTRO = "hmi"
DISTRO_NAME = "HMI OS"
DISTRO_VERSION = "1.0"

DISTRO_FEATURES:remove = "ptest"
DISTRO_FEATURES:append = " usrmerge systemd wayland pam opengl dbus "
VIRTUAL-RUNTIME_init_manager = "systemd"

ENABLE_BINARY_LOCALE_GENERATION = "1"
GLIBC_GENERATE_LOCALES = "en_US.UTF-8 uk_UA.UTF-8 C.UTF-8"
DEFAULT_LOCALE = "en_US.UTF-8"
IMAGE_LINGUAS = "en-us uk-ua"

PACKAGECONFIG:append:pn-qtbase = " eglfs sql-mysql"

PACKAGE_CLASSES = "package_rpm"

SDK_PACKAGE_CLASSES = "package_rpm"
TOOLCHAIN_TARGET_TASK:append = " qtwebengine"

LICENSE_FLAGS_ACCEPTED = "raspberrypi meta-raspberrypi-license synaptics-killswitch commercial"

INIT_MANAGER = "systemd"

IMAGE_FSTYPES = "ext4 wic.gz"

QT_EDITION = "opensource"
```

## layers/meta-hmi/conf/layer.conf
```bitbake
BBPATH .= ":${LAYERDIR}"
BBFILES += "\ 
  ${LAYERDIR}/recipes-*/*/*.bb \
  ${LAYERDIR}/recipes-*/*/*.bbappend \
"


BBFILE_COLLECTIONS += "hmi"
BBFILE_PATTERN_hmi = "^${LAYERDIR}/"
BBFILE_PRIORITY_hmi = "99"
LAYERSERIES_COMPAT_hmi = "scarthgap"
```
